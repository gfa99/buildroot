## configs/kernelsoft_j5_defconfig
```kconfig
# Target
BR2_aarch64=y
BR2_cortex_a55=y

# Toolchain
BR2_TOOLCHAIN_EXTERNAL=y
BR2_TOOLCHAIN_EXTERNAL_CUSTOM=y
# buildroot 不支持天准给的 gcc-ubuntu-9.3.0-2020.03-x86_64-aarch64-linux-gnu 工具链?!
# 找了半天总算找到J5原生根文件系统中与glibc相同版本(2.31)的交叉编译工具链，否则得自己构建交叉编译工具链了！！！
# https://armkeil.blob.core.windows.net/developer/Files/downloads/gnu-a/10.2-2020.11/binrel/gcc-arm-10.2-2020.11-x86_64-aarch64-none-linux-gnu.tar.xz
BR2_TOOLCHAIN_EXTERNAL_PATH="/disk/zzl/ros-cross_compile/j5/gcc-arm-10.2-2020.11-x86_64-aarch64-none-linux-gnu"
BR2_TOOLCHAIN_EXTERNAL_CUSTOM_PREFIX="$(ARCH)-none-linux-gnu"
BR2_TOOLCHAIN_EXTERNAL_GCC_10=y
# 注意 BR2_TOOLCHAIN_EXTERNAL_HEADERS_4_20 是指Linux内核头文件版本为 4.20.x
# 该版本来自于 BR2_TOOLCHAIN_EXTERNAL_PATH/BR2_TOOLCHAIN_EXTERNAL_CUSTOM_PREFIX/libc/usr/include/linux/version.h
BR2_TOOLCHAIN_EXTERNAL_HEADERS_4_20=y
BR2_TOOLCHAIN_EXTERNAL_CUSTOM_GLIBC=y
BR2_TOOLCHAIN_EXTERNAL_CXX=y

# Packages
## Interpreter languages and scripting -> python3
BR2_PACKAGE_PYTHON3=y
```

## configs/ks_ros_defconfig
```kconfig
#
# Target options
#
BR2_aarch64=y
BR2_cortex_a55=y

#
# Toolchain
#
BR2_TOOLCHAIN_EXTERNAL=y
BR2_TOOLCHAIN_EXTERNAL_CUSTOM=y
# buildroot 不支持天准给的 gcc-ubuntu-9.3.0-2020.03-x86_64-aarch64-linux-gnu 工具链?!
# 找了半天总算找到与J5原生根文件系统中glibc相同版本的交叉编译工具链，否则得自己构建交叉编译工具链了！！！
# https://armkeil.blob.core.windows.net/developer/Files/downloads/gnu-a/10.2-2020.11/binrel/gcc-arm-10.2-2020.11-x86_64-aarch64-none-linux-gnu.tar.xz
BR2_TOOLCHAIN_EXTERNAL_PATH="$(TOPDIR)/dl/gcc-arm-10.2-2020.11-x86_64-aarch64-none-linux-gnu"
BR2_TOOLCHAIN_EXTERNAL_CUSTOM_PREFIX="$(ARCH)-none-linux-gnu"
BR2_TOOLCHAIN_EXTERNAL_GCC_10=y
BR2_TOOLCHAIN_EXTERNAL_HEADERS_4_20=y
BR2_TOOLCHAIN_EXTERNAL_CUSTOM_GLIBC=y
BR2_TOOLCHAIN_EXTERNAL_CXX=y
BR2_TOOLCHAIN_EXTERNAL_FORTRAN=y
BR2_TOOLCHAIN_EXTERNAL_OPENMP=y

#
# Target packages
#
## Development tools -> ctest
BR2_PACKAGE_CMAKE_CTEST=y
## Interpreter languages and scripting -> python3
BR2_PACKAGE_PYTHON3=y
BR2_PACKAGE_PYTHON_PIP=y
```

## package/libasio/Config.in
```kconfig
config BR2_PACKAGE_LIBASIO
	bool "libasio"
	select BR2_PACKAGE_BOOST
	help
	  Asio is a cross-platform C++ library for network and low-level
	  I/O programming that provides developers with a consistent
	  asynchronous model using a modern C++ approach.

	  http://asio.sourceforge.net/

comment "libasio need to depends on basic boost"
```

## package/python-lark/Config.in
```kconfig
config BR2_PACKAGE_PYTHON_LARK
	bool "python-lark"
	help
	  Lark is a modern general-purpose parsing library for Python.
	  With Lark, you can parse any context-free grammar,
	  efficiently, with very little code.

	  https://pypi.python.org/pypi/lark
```

## package/python-packaging/Config.in
```kconfig
config BR2_PACKAGE_PYTHON_PACKAGING
	bool "python-packaging"
	help
	  This library provides utilities that implement the
		interoperability specifications which have clearly
		one correct behaviour (eg: PEP 440) or benefit greatly
		from having a single shared implementation (eg: PEP 425).

	  https://pypi.python.org/pypi/packaging
```
